## conf/layer.conf
```bitbake
BBPATH .= ":${LAYERDIR}"
BBFILES += "${LAYERDIR}/recipes-*/*/*.bb ${LAYERDIR}/recipes-*/*/*.bbappend"

BBFILE_COLLECTIONS += "opencpi"
BBFILE_PATTERN_opencpi = "^${LAYERDIR}/"
BBFILE_PRIORITY_opencpi = "5"

LAYERVERSION_opencpi = "1"

LAYERDEPENDS_opencpi = "core"

LAYERSERIES_COMPAT_opencpi = "warrior thud zeus"
```

## recipes-core/images/opencpi-runtime-image.wks
```
part        --label boot  --source bootimg-partition --ondisk mmcblk0 --fstype=vfat --align 4 --size 100M --active 
part /      --label root  --source rootfs            --ondisk mmcblk0 --fstype=ext4 --align 4 --fixed-size 2G
```
